/*
		 * Mali "dummy model" node - Device Tree integration, from the Arm GPU
		 * bug bounty virtual-platform how-to guide (insert before the final
		 * root-level "};" of the FVP device tree).
		 *
		 * reg/IRQs match the guide example. The FVP's GIC model accepts SPI 168
		 * (also used by PCI INTA on this platform); the dummy model does not
		 * generate interrupts, so the exact SPI is not exercised.
		 */
		gpu: gpu@6e000000 {
			compatible = "arm,mali-midgard";
			reg = <0x0 0x6e000000 0x0 0x200000>;
			interrupts = <0 168 4>, <0 168 4>, <0 168 4>;
			interrupt-names = "JOB", "MMU", "GPU";
		};